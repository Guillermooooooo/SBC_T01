## Piscifactoria/Piscifactoria/src/Kconfig.projbuild
```kconfig
menu "SSD1306 Configuration"

	config GPIO_RANGE_MAX
		int
		default 33 if IDF_TARGET_ESP32
		default 46 if IDF_TARGET_ESP32S2
		default 48 if IDF_TARGET_ESP32S3
		default 18 if IDF_TARGET_ESP32C2
		default 19 if IDF_TARGET_ESP32C3
		default 30 if IDF_TARGET_ESP32C6
		default 27 if IDF_TARGET_ESP32H2

	choice INTERFACE
		prompt "Interface"
		default I2C_INTERFACE
		help
			Select Interface.
		config I2C_INTERFACE
			bool "I2C Interface"
			help
				I2C Interface.
		config SPI_INTERFACE
			bool "SPI Interface"
			help
				SPI Interface.
	endchoice

	choice PANEL
		prompt "Panel Type"
		default SSD1306_128x64
		help
			Select Panel Type.
		config SSD1306_128x32
			bool "128x32 Panel"
			help
				Panel is 128x32.
		config SSD1306_128x64
			bool "128x64 Panel"
			help
				Panel is 128x64.
	endchoice

	config OFFSETX
		int "GRAM X OFFSET"
		range 0 99
		default 0
		help
			When your TFT have offset(X), set it.

	config FLIP
		bool "Flip upside down"
		default false
		help
			Flip upside down.

	config SCL_GPIO
		depends on I2C_INTERFACE
		int "SCL GPIO number"
		range 0 GPIO_RANGE_MAX
		default 22 if IDF_TARGET_ESP32
		default  2 if IDF_TARGET_ESP32S2 || IDF_TARGET_ESP32S3
		default  2 if IDF_TARGET_ESP32H2
		default  6 # C3 and others
		help
			GPIO number (IOxx) to I2C SCL.
			Some GPIOs are used for other purposes (flash connections, etc.) and cannot be used to I2C.
			GPIOs 35-39 are input-only so cannot be used as outputs.

	config SDA_GPIO
		depends on I2C_INTERFACE
		int "SDA GPIO number"
		range 0 GPIO_RANGE_MAX
		default 21 if IDF_TARGET_ESP32
		default  1 if IDF_TARGET_ESP32S2 || IDF_TARGET_ESP32S3
		default  1 if IDF_TARGET_ESP32H2
		default  5 # C3 and others
		help
			GPIO number (IOxx) to I2C SDA.
			Some GPIOs are used for other purposes (flash connections, etc.) and cannot be used to I2C.
			GPIOs 35-39 are input-only so cannot be used as outputs.

	config MOSI_GPIO
		depends on SPI_INTERFACE
		int "MOSI GPIO number"
		range 0 GPIO_RANGE_MAX
		default 23 if IDF_TARGET_ESP32
		default 35 if IDF_TARGET_ESP32S2 || IDF_TARGET_ESP32S3
		default  1 # C3 and others
		help
			GPIO number (IOxx) to SPI MOSI.
			Some GPIOs are used for other purposes (flash connections, etc.) and cannot be used to MOSI.
			On the ESP32, GPIOs 35-39 are input-only so cannot be used as outputs.
			On the ESP32-S2, GPIO 46 is input-only so cannot be used as outputs.

	config SCLK_GPIO
		depends on SPI_INTERFACE
		int "SCLK GPIO number"
		range 0 GPIO_RANGE_MAX
		default 18 if IDF_TARGET_ESP32
		default 36 if IDF_TARGET_ESP32S2 || IDF_TARGET_ESP32S3
		default  2 # C3 and others
		help
			GPIO number (IOxx) to SPI SCLK.
			Some GPIOs are used for other purposes (flash connections, etc.) and cannot be used to SCLK.
			On the ESP32, GPIOs 35-39 are input-only so cannot be used as outputs.
			On the ESP32-S2, GPIO 46 is input-only so cannot be used as outputs.

	config CS_GPIO
		depends on SPI_INTERFACE
		int "CS GPIO number"
		range 0 GPIO_RANGE_MAX
		default  5 if IDF_TARGET_ESP32
		default 34 if IDF_TARGET_ESP32S2 || IDF_TARGET_ESP32S3
		default 10 # C3 and others
		help
			GPIO number (IOxx) to SPI CS.
			Some GPIOs are used for other purposes (flash connections, etc.) and cannot be used to CS.
			GPIOs 35-39 are input-only so cannot be used as outputs.

	config DC_GPIO
		depends on SPI_INTERFACE
		int "DC GPIO number"
		range 0 GPIO_RANGE_MAX
		default  4 if IDF_TARGET_ESP32
		default 37 if IDF_TARGET_ESP32S2 || IDF_TARGET_ESP32S3
		default  3 # C3 and others
		help
			GPIO number (IOxx) to SPI DC.
			Some GPIOs are used for other purposes (flash connections, etc.) and cannot be used to DC.
			GPIOs 35-39 are input-only so cannot be used as outputs.

	config RESET_GPIO
		int "RESET GPIO number"
		range -1 GPIO_RANGE_MAX
		default 15 if IDF_TARGET_ESP32
		default 38 if IDF_TARGET_ESP32S2 || IDF_TARGET_ESP32S3
		default  4 # C3 and others
		help
			GPIO number (IOxx) to RESET.
			When it is -1, RESET isn't performed.
			Some GPIOs are used for other purposes (flash connections, etc.) and cannot be used to RESET.
			GPIOs 35-39 are input-only so cannot be used as outputs.

	choice I2C_PORT
		depends on I2C_INTERFACE
		prompt "I2C port that controls this bus"
		default I2C_PORT_0
		help
			Select I2C port that controls this bus.
		config I2C_PORT_0
			bool "I2C_PORT_0"
			help
				Use I2C_PORT_0.
		config I2C_PORT_1
			depends on IDF_TARGET_ARCH_XTENSA
			bool "I2C_PORT_1"
			help
				Use I2C_PORT_1.
	endchoice

	config LEGACY_DRIVER
		depends on I2C_INTERFACE
		bool "Force legacy i2c driver"
		default false
		help
			Force legacy i2c driver.

	choice SPI_HOST
		depends on SPI_INTERFACE
		prompt "SPI peripheral that controls this bus"
		default SPI2_HOST
		help
			Select SPI peripheral that controls this bus.
		config SPI2_HOST
			bool "SPI2_HOST"
			help
				Use SPI2_HOST. This is also called HSPI_HOST.
		config SPI3_HOST
			depends on IDF_TARGET_ARCH_XTENSA
			bool "SPI3_HOST"
			help
				USE SPI3_HOST. This is also called VSPI_HOST
	endchoice

endmenu

menu "esp32-ds18b20-example Configuration"

config ONE_WIRE_GPIO
    int "OneWire GPIO number"
	range 0 33
	default 4
	help
		GPIO number (IOxx) to access One Wire Bus.

		Some GPIOs are used for other purposes (flash connections, etc.) and cannot be used.

		GPIOs 34-39 are input-only so cannot be used to drive the One Wire Bus.

config ENABLE_STRONG_PULLUP_GPIO
    bool "Enable strong pull-up controlled by GPIO (MOSFET)"
    default n
    help
        An external circuit can be used to provide a strong pull-up to the One Wire Bus.
        This is useful when the bus has parasitic-powered devices and extra current is
        required to power them, such as during temperature ADC conversions.

        An example of such a circuit for the ESP32 is a P-channel MOSFET (such as the BS250)
        connected Source-to-Drain between a current-limiting resistor (e.g. 270ohm for 12mA
        max at 3.3V), itself connected to VCC, and the One Wire Bus data line. The Gate is
        connected to the GPIO specified here.

config STRONG_PULLUP_GPIO
    int "Strong pull-up GPIO number"
    range 0 33
    default 5
    help
		GPIO number (IOxx) to control the strong pull-up on the One Wire Bus, perhaps
		via a P-channel MOSFET between VCC and the One Wire Bus data line.

		This GPIO will be set as an output and driven high during temperature conversion.
		This would enable the MOSFET providing current to the devices.

		At all other times it will be driven low, switching off the MOSFET and allowing
		the One Wire Bus to operate normally.

		Some GPIOs are used for other purposes (flash connections, etc.) and cannot be used.

		GPIOs 34-39 are input-only so cannot be used to drive the One Wire Bus.
    depends on ENABLE_STRONG_PULLUP_GPIO

endmenu
```
